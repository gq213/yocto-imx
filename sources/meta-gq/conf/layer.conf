## sources/meta-gq/conf/layer.conf
```bitbake
# We have a conf and classes directory, add to BBPATH
BBPATH .= ":${LAYERDIR}"

# We have recipes-* directories, add to BBFILES
BBFILES += "${LAYERDIR}/recipes-*/*/*.bb \
            ${LAYERDIR}/recipes-*/*/*.bbappend"

BBFILE_COLLECTIONS += "meta-gq"
BBFILE_PATTERN_meta-gq = "^${LAYERDIR}/"
BBFILE_PRIORITY_meta-gq = "99"

LAYERDEPENDS_meta-gq = "core"
LAYERSERIES_COMPAT_meta-gq = "mickledore"
```

## sources/meta-gq/conf/machine/imx8mp-gq.conf
```bitbake
MACHINEOVERRIDES =. "imx8mp-lpddr4-evk:"
require conf/machine/include/imx8mp-evk.inc

KERNEL_DEVICETREE_BASENAME = "imx8mp-gq"
KERNEL_DEVICETREE = "freescale/imx8mp-gq_k.dtb"

UBOOT_CONFIG_BASENAME = "imx8mp_gq"

# Set DDR FIRMWARE
DDR_FIRMWARE_VERSION = "202006"
DDR_FIRMWARE_NAME = " \
    ddr4_dmem_1d_${DDR_FIRMWARE_VERSION}.bin \
    ddr4_imem_1d_${DDR_FIRMWARE_VERSION}.bin \
    ddr4_dmem_2d_${DDR_FIRMWARE_VERSION}.bin \
    ddr4_imem_2d_${DDR_FIRMWARE_VERSION}.bin \
"

IMXBOOT_TARGETS_BASENAME = "flash_gq"

IMX_DEFAULT_BSP = "nxp"

MACHINE_FEATURES_IMX_REMOVALS = "mrvl8997 nxp8997-pcie nxp8997-sdio nxp9098-pcie nxp9098-sdio"
MACHINE_FIRMWARE:remove = " linux-firmware-ath10k"

MACHINE_FEATURES_IMX_REMOVALS:append = " nxp8801-sdio nxp8987-sdio nxp8997-pcie nxp8997-sdio nxp9098-pcie nxp9098-sdio nxpiw416-sdio nxpiw612-sdio"
KERNEL_DEVICETREE:remove = " \
    freescale/imx8mp-evk-sof-pdm.dtb \
"

DELTA_KERNEL_DEFCONFIG = "imx.config gq.config"

SCMVERSION = "n"

BB_NO_NETWORK = "0"

DEFAULT_TIMEZONE = "Asia/Shanghai"
```
